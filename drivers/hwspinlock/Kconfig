## drivers/hwspinlock/Kconfig
```kconfig
#
# Generic HWSPINLOCK framework
#

config HWSPINLOCK
	tristate "Generic Hardware Spinlock framework"
	depends on ARCH_OMAP4
	help
	  Say y here to support the generic hardware spinlock framework.
	  You only need to enable this if you have hardware spinlock module
	  on your system (usually only relevant if your system has remote slave
	  coprocessors).

	  If unsure, say N.

config HWSPINLOCK_OMAP
	tristate "OMAP Hardware Spinlock device"
	depends on HWSPINLOCK && ARCH_OMAP4
	help
	  Say y here to support the OMAP Hardware Spinlock device (firstly
	  introduced in OMAP4).

	  If unsure, say N.

config HWSPINLOCK_TEST
	tristate "Test module for the common HWSPINLOCK interface"
	help
	  This enables a test module for the common hardware spinlock
	  interface. It is only needed for testing purposes.

	  If unsure, say N.
```

## drivers/remoteproc/Kconfig
```kconfig
#
# Generic framework for controlling remote processors
#

# Remote proc gets selected by whoever wants it.
config REMOTE_PROC
	tristate

# can't be tristate, due to omap_device_* and omap_hwmod_* dependency
config OMAP_REMOTE_PROC
	bool "OMAP remoteproc support"
	depends on ARCH_OMAP4
	select REMOTE_PROC
	default y
	help
	  Say y here to support OMAP's remote processors (dual M3
	  and DSP on OMAP4) via the remote processor framework.

	  Currently only supported on OMAP4.

	  Usually you want to say y here, in order to enable multimedia
	  use-cases to run on your platform (multimedia codecs are
	  offloaded to remote DSP processors using this framework).

	  It's safe to say n here if you're not interested in multimedia
	  offloading or just want a bare minium kernel.

config DAVINCI_REMOTE_PROC
	bool "Davinci remoteproc support"
	depends on ARCH_DAVINCI_DA850
	select REMOTE_PROC
	default y
	help
	  Say y here to support Davinci's remote processors via the remote
	  processor framework.

	  Currently only supported is the OMAPL138 chip with its DSP.

	  Usually you want to say y here, in order to enable multimedia
	  use-cases to run on your platform (multimedia codecs are
	  offloaded to remote DSP processors using this framework).

	  It's safe to say n here if you're not interested in multimedia
	  offloading or just want a bare minium kernel.
```

## drivers/rpmsg/Kconfig
```kconfig
config RPMSG
	tristate "Virtio-based remote processor messaging bus"
	depends on VIRTIO
	---help---
	  This virtio driver provides support for shared-memory-based
          remote processor messaging, by registering the RPMSG bus which
          in turn enables a plethora of IPC drivers.

	  Such support is usually required to offload cpu-intensive
          or latency-sensitive tasks to specialized remote processors with
          dedicated hardware accelerators and/or real-time properties.

	  If unsure, say N.
```
